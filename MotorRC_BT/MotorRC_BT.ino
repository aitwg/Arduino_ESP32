// ESP32 Bluetooth Remote Control CAR
// (@)gausskao
// 2020/05/17 v0.1 created. BlueTooth remote control crated.
// 2020/05/19 v0.2 added new CMD compatible with Arduino BlueControl (w/ voice command)
// 2020/05/20 v0.5 added new CMD compatible with Bluetooth RC Controller.
// 2020/05/21 v0.7 added Red/Blue LED support
// 2020/05/21 v0.8 added OLED panel support.

#include "BluetoothSerial.h"

#if !defined(CONFIG_BT_ENABLED) || !defined(CONFIG_BLUEDROID_ENABLED)
#error Bluetooth is not enabled! Please run `make menuconfig` to and enable it
#endif

#include <Arduino.h>
#include <U8g2lib.h>

#define ESP32_SCL 22
#define ESP32_SDA 21
U8G2_SSD1306_128X64_NONAME_1_SW_I2C u8g2(U8G2_R0, /* clock=*/ESP32_SCL, /* data=*/ESP32_SDA, /* reset=*/ U8X8_PIN_NONE);  //ESP8266板子搭配SSD1306用這行

#define imgWidth 128
#define imgHeight 48  //這裡只用到48的高度，因為上方要放文字

static const unsigned char PROGMEM android[] = {
0x00, 0x00, 0x00, 0x00, 0x00, 0x00, 0x00, 0x00, 0x00, 0x00, 0x00, 0x00, 0x00, 0x00, 0x00, 0x00, 
0x00, 0x00, 0x00, 0x00, 0x00, 0x00, 0x10, 0x00, 0x00, 0x08, 0x00, 0x00, 0x00, 0x00, 0x00, 0x00, 
0x00, 0x00, 0x00, 0x00, 0x00, 0x00, 0x20, 0x00, 0x00, 0x04, 0x00, 0x00, 0x00, 0x00, 0x00, 0x00, 
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0x00, 0x00, 0x00, 0x00, 0x00, 0x00, 0x00, 0x00, 0x00, 0x00, 0x00, 0x00, 0x00, 0x00, 0x00, 0x00,};

BluetoothSerial SerialBT;

#define RC_LEFT   0
#define RC_RIGHT  1
#define RC_UP     2
#define RC_DOWN   3

#define IN1 32
#define IN2 33
#define IN3 25
#define IN4 26

#define ENA 14
#define ENB 27

#define LED_RED   13
#define LED_BLUE  15
#define PWM_BUZ   16

#define BUZ_CHANNEL 3

// Set up the rgb led names
uint8_t PWMA = ENA;
uint8_t PWMB = ENB;

#define SP10 92
#define SP9 86
#define SP8 80
#define SP7 74
#define SP6 68
#define SP5 62
#define SP4 56
#define SP3 50
#define SP2 44
#define SP1 38
#define SP0 32

int CAR_STATE=0;
#define CAR_FORWARD 1
#define CAR_BACK    2
#define CAR_LEFT    3
#define CAR_RIGHT   4
#define CAR_STOP    0

int CAR_SPEED=5;
bool bUpdateLED=true;


void setup() {
  
  Serial.begin(115200);
  SerialBT.begin("ESP32Car01"); //Bluetooth device name
  Serial.println("The device started, now you can pair it with bluetooth!");
  
  pinMode(IN1, OUTPUT);
  pinMode(IN2, OUTPUT);
  pinMode(IN3, OUTPUT);
  pinMode(IN4, OUTPUT);
  
  pinMode(ENA, OUTPUT);
  pinMode(ENB, OUTPUT);
  
  pinMode(LED_RED, OUTPUT);
  pinMode(LED_BLUE, OUTPUT);
  //pinMode(PWM_BUZ, OUTPUT);
  
  ledcAttachPin(PWMA, 1); // assign RGB led pins to channels
  ledcAttachPin(PWMB, 2);
  //ledcAttachPin(PWM_BUZ, BUZ_CHANNEL);  // assign PWM_BUZ to Channel
  
  // Initialize channels 
  // channels 0-15, resolution 1-16 bits, freq limits depend on resolution
  // ledcSetup(uint8_t channel, uint32_t freq, uint8_t resolution_bits);
  ledcSetup(1, 500, 8); // 12 kHz PWM, 8-bit resolution
  ledcSetup(2, 500, 8);

  //ledcSetup(BUZ_CHANNEL,500, 8);
  
  ledcWrite(1, SP5);
  ledcWrite(2, SP5);

  digitalWrite(LED_RED, LOW);
  digitalWrite(LED_BLUE, LOW);

  u8g2.begin(); 
}

void alarm(bool status){
  if (status) {
    for (int i=0; i<5; i++) {
      ledcSetup(BUZ_CHANNEL,500, 8);
      ledcWrite(BUZ_CHANNEL, 128);
      delay(100);
    }
    ledcSetup(BUZ_CHANNEL,500, 8);
    ledcWrite(BUZ_CHANNEL,0);
    delay(800);
  } else
  {
    ledcSetup(BUZ_CHANNEL,500, 8);
    ledcWrite(BUZ_CHANNEL,0);
  }   
}

void RedLight(bool status)
{
  return status ? digitalWrite(LED_RED, HIGH) : digitalWrite(LED_RED, LOW);
}

void BlueLight(bool status)
{
  return status ? digitalWrite(LED_BLUE, HIGH) : digitalWrite(LED_BLUE, LOW);
}

void MotorSpeed(int index) {
  if (CAR_SPEED==index) return;
  CAR_SPEED=index;
  Serial.print(index);
  Serial.println("Motor::Speed");
  switch(index)
  {
    case 10:ledcWrite(1, SP10);ledcWrite(2, SP10);break;
    case 9:ledcWrite(1, SP9);ledcWrite(2, SP9);break;
    case 8:ledcWrite(1, SP8);ledcWrite(2, SP8);break;
    case 7:ledcWrite(1, SP7);ledcWrite(2, SP7);break;
    case 6:ledcWrite(1, SP6);ledcWrite(2, SP6);break;
    case 5:ledcWrite(1, SP5);ledcWrite(2, SP5);break;
    case 4:ledcWrite(1, SP4);ledcWrite(2, SP4);break;
    case 3:ledcWrite(1, SP3);ledcWrite(2, SP3);break;
    case 2:ledcWrite(1, SP2);ledcWrite(2, SP2);break;
    case 1:ledcWrite(1, SP1);ledcWrite(2, SP1);break;
    case 0:ledcWrite(1, SP0);ledcWrite(2, SP0);break;
    default:ledcWrite(1, SP5);ledcWrite(2, SP5);break;
  }  
}

void MotorLeft() {
  if (CAR_STATE==CAR_LEFT)  return;
  CAR_STATE=CAR_LEFT;
  Serial.println("Motor::Left");
  digitalWrite(IN1, LOW);   
  digitalWrite(IN2, LOW);
  digitalWrite(IN3, HIGH);
  digitalWrite(IN4, LOW);

}


void MotorRight() {
  if (CAR_STATE==CAR_RIGHT)  return;
  CAR_STATE=CAR_RIGHT;
  Serial.println("Motor::Right");
  digitalWrite(IN1, LOW);   
  digitalWrite(IN2, LOW);
  digitalWrite(IN3, LOW);
  digitalWrite(IN4, HIGH);
}

void MotorUp()  {
  if (CAR_STATE==CAR_FORWARD)  return;
  CAR_STATE=CAR_FORWARD;
  Serial.println("Motor::Up");
  digitalWrite(IN1, HIGH);   
  digitalWrite(IN2, LOW);
  digitalWrite(IN3, HIGH);
  digitalWrite(IN4, LOW);

}

void MotorDown() {
  if (CAR_STATE==CAR_BACK)  return;
  CAR_STATE=CAR_BACK;
  Serial.println("Motor::Down");
  digitalWrite(IN1, LOW);   
  digitalWrite(IN2, HIGH);
  digitalWrite(IN3, LOW);
  digitalWrite(IN4, HIGH);

}

void MotorStop() {
  Serial.println("Motor::Stop");
  digitalWrite(IN1, LOW);   
  digitalWrite(IN2, LOW);
  digitalWrite(IN3, LOW);
  digitalWrite(IN4, LOW);

}

char cmd = 'S';
char prevCmd = 'A';
int velocity = 0;  
unsigned long timer0 = 2000;  //Stores the time (in millis since execution started)
unsigned long timer1 = 0;  //Stores the time when the last command was received from the phone

void loop() {
  if (Serial.available()) {
    SerialBT.write(Serial.read());
  }
  if (SerialBT.available()) {
    timer1 = millis();  
    prevCmd = cmd;
    cmd = SerialBT.read();
    //Change pin mode only if new command is different from previous.  
    if(cmd!=prevCmd){
    
      Serial.write(cmd);
      switch(cmd) 
      {
      case 'L' : MotorLeft();break;
      case 'R' : MotorRight();break;
      case 'F' : MotorUp();break;
      case 'B' : MotorDown();break;
      case 'q' : MotorSpeed(10);break;
      case '9' : MotorSpeed(9);break;
      case '8' : MotorSpeed(8);break;
      case '7' : MotorSpeed(7);break;
      case '6' : MotorSpeed(6);break;
      case '5' : MotorSpeed(5);break;
      case '4' : MotorSpeed(4);break;
      case '3' : MotorSpeed(3);break;
      case '2' : MotorSpeed(2);break;
      case '1' : MotorSpeed(1);break;
      case '0' : MotorSpeed(0);MotorStop();break;
      case 'X' : MotorStop();break;
      case 'x' : MotorStop();break;
      case 'W' : BlueLight(true);break;
      case 'w' : BlueLight(false);break;
      case 'U' : RedLight(true);break;
      case 'u' : RedLight(false);break;
      //case 'V' : alarm(true);break;
      //case 'v' : alarm(false);break;
      default : break;
      }
    }
  }
  if (bUpdateLED) {
    u8g2.setFont(u8g2_font_HelvetiPixelOutline_te); //設定字型
    u8g2.firstPage();
    do {
      u8g2.drawStr(0,13,"Hello Arduino");  //輸出文字
      u8g2.drawXBMP(0,16, imgWidth, imgHeight, android);  //繪圖
    } while ( u8g2.nextPage() );
    bUpdateLED=false;
  }
  delay(20);
}
